## configs/ksil_arm32r_nsh_core0/defconfig
```kconfig
#include "../sil_arm32r_nsh_core0/defconfig"

# CONFIG_ALLSYMS is not set
# CONFIG_DEBUG_FULLOPT is not set
# CONFIG_DRIVERS_VIRTIO_RNG is not set
# CONFIG_LIB_SYSCALL_EXTENSION is not set
# CONFIG_NCPUS is not set
# CONFIG_SYSTEM_PING6 is not set
CONFIG_ARCH_USE_MPU=y
CONFIG_ARM_MPU=y
CONFIG_ARM_MPU_NREGIONS=16
CONFIG_BUILD_PROTECTED=y
CONFIG_DEBUG_RPTUN=y
CONFIG_DRIVERS_NOTE=y
CONFIG_DRIVERS_NOTERAM=y
CONFIG_DRIVERS_NOTERAM_BUFSIZE=20480
CONFIG_FLASH_SIZE=5242880
CONFIG_INIT_ENTRYPOINT="nsh_main"
CONFIG_INIT_PRIORITY=253
CONFIG_INIT_STACKSIZE=4096
CONFIG_MM_BACKTRACE=-1
CONFIG_MM_KERNEL_HEAP=y
CONFIG_NUTTX_USERSPACE=0x00600000
CONFIG_PASS1_BUILDIR="../vendor/openvela/boards/sil/kernel"
CONFIG_RAM_SIZE=4194304
CONFIG_SCHED_INSTRUMENTATION=y
CONFIG_SCHED_INSTRUMENTATION_DUMP=y
CONFIG_SCHED_INSTRUMENTATION_IRQHANDLER=y
CONFIG_SCHED_INSTRUMENTATION_SWITCH=y
CONFIG_SYSLOG_RPMSG_SERVER=y
```
